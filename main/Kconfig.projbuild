## main/Kconfig.projbuild
```kconfig
menu "Example Configuration"

    choice EXAMPLE_USE_IO_TYPE
        prompt "I/O Capability - bonding method"
        default BLE_SM_IO_CAP_NO_IO
        help
            I/O capability of device.

        config BLE_SM_IO_CAP_DISP_ONLY
            bool "DISPLAY ONLY, display predefined 6 digits on client (central) side"
        config BLE_SM_IO_CAP_NO_IO
            bool "Just works, we will bond without questions"
    endchoice

    config EXAMPLE_IO_TYPE
        int
        default 0 if BLE_SM_IO_CAP_DISP_ONLY
        default 3 if BLE_SM_IO_CAP_NO_IO

    config EXAMPLE_BONDING
        bool
        default y
        prompt "Use Bonding"
        help
            Use this option to enable/disable bonding.

    config EXAMPLE_MITM
        bool
        default y
        prompt "MITM security"
        help
            Use this option to enable/disable MITM security.

    config EXAMPLE_USE_SC
        bool
        depends on BT_NIMBLE_SM_SC
        default y
        prompt "Use Secure Connection feature"
        help
            Use this option to enable/disable Security Manager Secure Connection 4.2 feature.

    config EXAMPLE_DISP_PASSWD
        int "password for bonding"
        default "123456"
        range 100000 999999
        depends on BLE_SM_IO_CAP_DISP_ONLY
        prompt "Bonding numeric password"
        help
            Password for bonding. Use digits only.

    config BLINK_GPIO
        int "Blink GPIO number for CAPSLOCK"
        range 0 34
        default 16
        help
            GPIO number (IOxx) to show caps lock on and off.
            CapsLock LED does not work yet.
            GPIOs 35-39 are input-only so cannot be used as outputs.

endmenu
```

## sdkconfig.defaults
```kconfig
# Override some defaults so BT stack is enabled
# in this example

#
# BT config
#
CONFIG_BT_ENABLED=y
CONFIG_BTDM_CTRL_MODE_BLE_ONLY=y
CONFIG_BTDM_CTRL_MODE_BR_EDR_ONLY=n
CONFIG_BTDM_CTRL_MODE_BTDM=n
CONFIG_BT_BLUEDROID_ENABLED=n
CONFIG_BT_NIMBLE_ENABLED=y
CONFIG_BT_NIMBLE_SVC_GAP_DEVICE_NAME="nimble_kbd"
CONFIG_BT_NIMBLE_SVC_GAP_APPEARANCE=0x03c1
CONFIG_BT_NIMBLE_SVC_GAP_CENTRAL_ADDRESS_RESOLUTION=0
CONFIG_BT_NIMBLE_SM_LEGACY=y
CONFIG_BT_NIMBLE_SM_SC=y
CONFIG_BT_NIMBLE_ROLE_PERIPHERAL=y
CONFIG_BT_NIMBLE_MAX_CCCDS=16
CONFIG_BT_NIMBLE_NVS_PERSIST=y
CONFIG_FREERTOS_HZ=1000
CONFIG_ESP32_DEFAULT_CPU_FREQ_240=y
CONFIG_ESP32_DEFAULT_CPU_FREQ_MHZ=240
CONFIG_ESPTOOLPY_FLASHSIZE_4MB=y
CONFIG_ESPTOOLPY_FLASHSIZE="4MB"
CONFIG_ESPTOOLPY_FLASHSIZE_DETECT=y
```
